## software/firmware/src/drivers/Kconfig
```kconfig
menu "Peripheral device drivers"

    menu "I2C Device Configuration"
    
        config I2C_DEVICE_AXP192
            bool "AXP192 PMU"
            depends on BLUETHROAD_TARGET_DEVICE_M5STICKCPLUS || BLUETHROAD_TARGET_DEVICE_M5CORE2AWS
            default y
            help
                Use Axp192 Power Management Unit

        config I2C_DEVICE_AXP192_BATTERY_CAPACITY_MAH
            int "Chargable battery capacity in mAh"
            depends on I2C_DEVICE_AXP192
            default 500 if BLUETHROAD_TARGET_DEVICE_M5CORE2AWS
            default 120 if BLUETHROAD_TARGET_DEVICE_M5STICKCPLUS
            help
                Chargable battery capacity in mAh

        choice I2C_DEVICE_AXP192_CHARGING_CURRENT
            prompt "Charging current configuation"
            depends on I2C_DEVICE_AXP192
            default I2C_DEVICE_AXP192_CHARGING_CURRENT_03C
            help
                Normally, the charging current (mA or A) of the lithium-ion battery 
                should be set to 30% of the battery capacity (mAh or Ah). 
                A low charging current will help extend the battery life, and a high 
                charging current will help shorten the totaly charging time.

            config I2C_DEVICE_AXP192_CHARGING_CURRENT_01C
                bool "0.1C"
            config I2C_DEVICE_AXP192_CHARGING_CURRENT_03C
                bool "0.3C"
            config I2C_DEVICE_AXP192_CHARGING_CURRENT_05C
                bool "0.5C"
            config I2C_DEVICE_AXP192_CHARGING_CURRENT_07C
                bool "0.7C"
            config I2C_DEVICE_AXP192_CHARGING_CURRENT_10C
                bool "1.0C"
        endchoice

        config I2C_DEVICE_AXP192_SOFTWARE_LED
            bool "Drive LED with GPIO1"
            depends on I2C_DEVICE_AXP192 && BLUETHROAD_TARGET_DEVICE_M5CORE2AWS
            default y
            help
                Drive LED with GPIO1, which is connected to the LED 
                on M5Core2 for AWS.

        config I2C_DEVICE_AXP192_SOFTWARE_LED_PWM
            bool "Drive LED with AXP192 PWM generator"
            depends on I2C_DEVICE_AXP192_SOFTWARE_LED
            default y
            help
                Drive LED with AXP192 PWM generator.
                Using PWM waveform to drive LED can make the brightness 
                change more smoothly and provide a better user experience.

        config I2C_DEVICE_AXP2101
            bool "AXP2101 PMU"
            depends on BLUETHROAD_TARGET_DEVICE_M5CORES3
            default y
            help
                Use Axp2101 Power Management Unit

        config I2C_DEVICE_BM8563
            bool "BM8563 RTC"
            depends on BLUETHROAD_TARGET_DEVICE_M5STICKCPLUS || BLUETHROAD_TARGET_DEVICE_M5CORE2AWS || BLUETHROAD_TARGET_DEVICE_M5CORES3
            default y
            help
                Use BM8563 Real Time Clock

        config I2C_DEVICE_FT6X36U
            bool "FT6X36U Touch Panel"
            depends on BLUETHROAD_TARGET_DEVICE_M5CORE2AWS || BLUETHROAD_TARGET_DEVICE_M5CORES3
            default y
            help
                Use FT6X36U Touch Panel

        config I2C_DEVICE_DPS3XX
            bool "DPS3XX Pressure Sensor"
            depends on BLUETHROAD_TARGET_DEVICE_M5STICKCPLUS || BLUETHROAD_TARGET_DEVICE_M5CORE2AWS || BLUETHROAD_TARGET_DEVICE_M5CORES3
            default y
            help
                Use DPS3XX Pressure Sensor

        config I2C_DEVICE_BMP280
            bool "BMP280 Pressure Sensor"
            depends on BLUETHROAD_TARGET_DEVICE_M5STICKCPLUS || BLUETHROAD_TARGET_DEVICE_M5CORE2AWS || BLUETHROAD_TARGET_DEVICE_M5CORES3
            default y
            help
                Use BMP280 Pressure Sensor

        config I2C_DEVICE_MPU6886
            bool "MPU6886 IMU"
            depends on BLUETHROAD_TARGET_DEVICE_M5STICKCPLUS || BLUETHROAD_TARGET_DEVICE_M5CORE2AWS || BLUETHROAD_TARGET_DEVICE_M5CORES3
            default y
            help
                Use MPU6886 IMU

        config I2C_DEVICE_BMI270
            bool "BMI270 IMU"
            depends on BLUETHROAD_TARGET_DEVICE_M5CORE2AWS || BLUETHROAD_TARGET_DEVICE_M5CORES3
            default y
            help
                Use BMI270 IMU

        config I2C_DEVICE_LIS2MDL
            bool "LIS2MDL Magnetometer"
            depends on BLUETHROAD_TARGET_DEVICE_M5CORE2AWS || BLUETHROAD_TARGET_DEVICE_M5CORES3
            default y
            help
                Use LIS2MDL Magnetometer

        config I2C_DEVICE_BMM150
            bool "BMM150 Magnetometer"
            depends on BLUETHROAD_TARGET_DEVICE_M5CORE2AWS || BLUETHROAD_TARGET_DEVICE_M5CORES3
            default y
            help
                Use BMM150 Magnetometer

        config I2C_DEVICE_SHTXX
            bool "SHTXX Temperature and Humidity Sensor"
            depends on BLUETHROAD_TARGET_DEVICE_M5CORE2AWS || BLUETHROAD_TARGET_DEVICE_M5CORES3
            default y
            help
                Use SHTXX Temperature and Humidity Sensor

    endmenu

    menu "I2S Device Configuration"

        config I2S_DEVICE_NS4168
            bool "NS4168 Audio Amplifier"
            depends on BLUETHROAD_TARGET_DEVICE_M5CORE2AWS
            default y
            help
                Use NS4168 Audio Amplifier

        config I2S_DEVICE_AW88298
            bool "AW88298 Audio Amplifier"
            depends on BLUETHROAD_TARGET_DEVICE_M5CORES3
            default y
            help
                Use AW88298 Audio Amplifier

    endmenu

    menu "GNSS Moudule Configuration"
        depends on BLUETHROAD_TARGET_DEVICE_M5CORE2AWS || BLUETHROAD_TARGET_DEVICE_M5CORES3

        config GNSS_MODULE_ENABLED
            bool "Enable GNSS module"
            default y
            help
                GNSS Module is a global positioning wireless communication module 
                featuring the NEO-M9N-00B GPS module. Compatible with multiple 
                satellite positioning systems.
                In addition to its exceptional positioning capabilities, the module 
                integrates mutible sensors for comprehensive geographic information 
                measuring. It incorporates a BMI270 six-axis attitude sensor, 
                a BMM150 three-axis magnetometer, and a BMP280 barometric sensor.

        config GNSS_UART_PORT
            int "UART port"
            depends on GNSS_MODULE_ENABLED
            default 2 if BLUETHROAD_TARGET_DEVICE_M5CORE2AWS
            default 2 if BLUETHROAD_TARGET_DEVICE_M5CORES3
            range 1 2
            help
                UART port number for GNSS module

        config GNSS_UART_PORT_TX_PIN
            int "TX (GPIO pin)"
            depends on GNSS_MODULE_ENABLED
            default 14 if BLUETHROAD_TARGET_DEVICE_M5CORE2AWS
            default 14 if BLUETHROAD_TARGET_DEVICE_M5CORES3
            help
                TX pin for GNSS module UART port

        config GNSS_UART_PORT_RX_PIN
            int "RX (GPIO pin)"
            depends on GNSS_MODULE_ENABLED
            default 13 if BLUETHROAD_TARGET_DEVICE_M5CORE2AWS
            default 13 if BLUETHROAD_TARGET_DEVICE_M5CORES3
            help
                RX pin for GNSS module UART port

        config GNSS_UART_PORT_BAUDRATE
            int "Baudrate"
            depends on GNSS_MODULE_ENABLED
            default 38400 if BLUETHROAD_TARGET_DEVICE_M5CORE2AWS
            default 38400 if BLUETHROAD_TARGET_DEVICE_M5CORES3
            help
                Baudrate for GNSS module UART port

    endmenu

endmenu
```
